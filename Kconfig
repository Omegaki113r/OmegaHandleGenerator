## Kconfig
```kconfig
menu "OmegaHandleGenerator Configuration"
    config OMEGA_HANDLE_GENERATOR_VERBOSE
        bool "Enable Handle Generator Verbose logs"
        default "n"
        help
            This is used to enable or disable verbose logs
    config OMEGA_HANDLE_GENERATOR_DEBUG
        bool "Enable Handle Generator Debug logs"
        default "n"
        help
            This is used to enable or disable debug logs
    config OMEGA_HANDLE_GENERATOR_INFO
        bool "Enable Handle Generator Info logs"
        default "n"
        help
            This is used to enable or disable info logs
    config OMEGA_HANDLE_GENERATOR_WARN
        bool "Enable Handle Generator Warn logs"
        default "n"
        help
            This is used to enable or disable warn logs
    config OMEGA_HANDLE_GENERATOR_ERROR
        bool "Enable Handle Generator Error logs"
        default "n"
        help
            This is used to enable or disable error logs
    choice
        prompt "What generator to use"
        default OMEGA_LIBC_RANDOM_GEN
        config OMEGA_ESP_HARDWARE_GEN
            bool "Use ESP hardware random number generator"
        config OMEGA_STC_RANDOM_GEN
            bool "Use STC library generator"
        config OMEGA_LIBC_RANDOM_GEN
            bool "Use LIB C generator"
    endchoice
endmenu
```
